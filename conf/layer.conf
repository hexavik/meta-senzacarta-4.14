## conf/layer.conf
```bitbake
# We have a conf and classes directory, add to BBPATH
BBPATH .= ":${LAYERDIR}"

# We have recipes-* directories, add to BBFILES
BBFILES += "${LAYERDIR}/recipes-*/*/*.bb \
            ${LAYERDIR}/recipes-*/*/*.bbappend"

BBFILE_COLLECTIONS += "senzacarta"
BBFILE_PATTERN_senzacarta = "^${LAYERDIR}/"
BBFILE_PRIORITY_senzacarta = "6"
LAYERDEPENDS_senzacarta = "core"
LAYERSERIES_COMPAT_senzacarta = "warrior"

# Add the Freescale license
FSL_EULA_FILE = "${LAYERDIR}/EULA"

IMX_MIRROR ?= "https://www.nxp.com/lgfiles/NMG/MAD/YOCTO/"
QORIQ_MIRROR ?= "http://git.freescale.com/source/"

# FIXME: set this to avoid changing all the recipes that use it
FSL_MIRROR ?= "${IMX_MIRROR}"

MIRRORS += " \
${IMX_MIRROR}   http://download.ossystems.com.br/bsp/freescale/source/ \n \
"

# Let us add layer-specific bbappends which are only applied when that
# layer is included in our configuration
BBFILES += "${@' '.join('${LAYERDIR}/%s/recipes*/*/*.bbappend' % layer \
	for layer in BBFILE_COLLECTIONS.split())}"

# Add layer-specific bb files too
BBFILES += "${@' '.join('${LAYERDIR}/%s/recipes*/*/*.bbappend' % layer \
	for layer in BBFILE_COLLECTIONS.split())}" 
```

## conf/machine/imx7dsenzacarta.conf
```bitbake
#@TYPE: Machine
#@NAME: i.MX7D SenzaCarta V1
#@SOC: i.MX7D
#@DESCRIPTION: Machine configuration for i.MX7D SenzaCarta
#@MAINTAINER: Vikrant A. P. <vikrant.ap@econote.in>

MACHINEOVERRIDES =. "mx7:mx7d:"

require conf/machine/include/imx-base.inc
require conf/machine/include/tune-cortexa7.inc

MACHINE_FEATURES += " epdc wifi bluetooth"

PREFERRED_PROVIDER_u-boot_mx7 = "u-boot-senzacarta"
PREFERRED_PROVIDER_virtual/bootloader_mx7 = "u-boot-senzacarta"
PREFERRED_PROVIDER_virtual/kernel_mx7 = "linux-senzacarta"
PREFERRED_VERSION_linux-senzacarta ?= "4.14"

KERNEL_DEVICETREE = "imx7d-sdb.dtb imx7d-sdb-epdc.dtb"
KERNEL_DEVICETREE_use-mainline-bsp = "imx7d-sdb.dtb"

UBOOT_CONFIG ??= "sd"
UBOOT_CONFIG[sd] = "mx7dsabresd_config,sdcard"
UBOOT_CONFIG[epdc] = "mx7dsabresd_epdc_config"
UBOOT_CONFIG[mfgtool] = "mx7dsabresd_config"

MACHINE_EXTRA_RRECOMMENDS += "firmware-imx-brcm"
```
